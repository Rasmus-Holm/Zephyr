## CMakeLists.txt
```
cmake_minimum_required(VERSION 3.20.0)

# Board: ESP32-C6 DevKitC (4 MB flash). Kan overskrives med `west build -b ...`.
if(NOT DEFINED BOARD)
	set(BOARD esp32c6_devkitc/esp32c6/hpcore)
endif()

find_package(Zephyr REQUIRED HINTS $ENV{ZEPHYR_BASE})
project(esp32c6_app)

target_sources(app PRIVATE src/main.c)
```

## prj.conf
```kconfig
# Konsol på boardets USB Serial/JTAG-controller (vælges via app.overlay).
# Enheden vises som /dev/ttyACM0 når DevKitC'en sluttes til USB.
CONFIG_SERIAL=y
CONFIG_SERIAL_ESP32_USB=y

# Zephyr logging
CONFIG_LOG=y
# 0=OFF 1=ERR 2=WRN 3=INF 4=DBG
CONFIG_LOG_DEFAULT_LEVEL=3
```

## src/main.c
```c
#include <zephyr/kernel.h>
#include <zephyr/logging/log.h>

LOG_MODULE_REGISTER(zephyr_app, LOG_LEVEL_INF);

int main(void)
{
	printk("\nHello World! %s\n", CONFIG_BOARD);

	LOG_INF("USB Serial/JTAG konsol klar");
	LOG_WRN("Dette er en test-advarsel (LOG_WRN)");
	LOG_ERR("Dette er en test-fejl (LOG_ERR)");

	while (1) {
		LOG_INF("Kører - uptime: %llu ms", k_uptime_get());
		k_sleep(K_MSEC(5000));
	}

	return 0;
}
```
