## prj.conf
```kconfig
# Console/Logging
CONFIG_SERIAL=y
CONFIG_UART_INTERRUPT_DRIVEN=y
CONFIG_LOG=y
CONFIG_LOG_DEFAULT_LEVEL=3
CONFIG_MODBUS_LOG_LEVEL_DBG=y

# Modbus RTU Server
CONFIG_MODBUS=y
CONFIG_MODBUS_ROLE_SERVER=y
CONFIG_MODBUS_SERIAL=y
CONFIG_MODBUS_NONCOMPLIANT_SERIAL_MODE=y


# 1-Wire + DS18B20
CONFIG_W1=y
CONFIG_W1_LOG_LEVEL_INF=y
CONFIG_SENSOR=y
CONFIG_DS18B20=y
CONFIG_SENSOR_LOG_LEVEL_INF=y
```

## src/main.c
```c
#include <zephyr/kernel.h>
#include <zephyr/logging/log.h>
#include <stdlib.h>

#include "sensors.h"
#include "modbus_server.h"

LOG_MODULE_REGISTER(main, LOG_LEVEL_INF);

int main(void)
{
	LOG_INF("TEST: Modbus debug firmware er startet");
	LOG_INF("Modbus RTU slave starting (DS18B20 on GPIO4, UART2 16/17)");

	sensors_init();

	if (modbus_server_init() < 0) {
		LOG_ERR("Failed to init Modbus server");
		return 0;
	}

	while (1) {
		sensors_update();
		const struct sensor_data *sd = sensors_get();
		if (sd->valid) {
			int temp_abs = abs(sd->temp_c_x10);
			LOG_INF("Temp: %d.%d C (reg0=%d), uptime_lsw=%u",
				sd->temp_c_x10 / 10, temp_abs % 10,
				sd->temp_c_x10, sd->uptime_s_lsw);
		} else {
			LOG_WRN("Sensor not valid");
		}
		k_sleep(K_SECONDS(2));
	}

	return 0;
}
```

## src/modbus_server.c
```c
#include <zephyr/kernel.h>
#include <zephyr/logging/log.h>
#include <zephyr/modbus/modbus.h>

#include "modbus_server.h"
#include "sensors.h"

LOG_MODULE_REGISTER(modbus_server, LOG_LEVEL_DBG);

#define MODBUS_NODE DT_COMPAT_GET_ANY_STATUS_OKAY(zephyr_modbus_serial)
#define SLAVE_UNIT_ID 1

static int holding_reg_rd(uint16_t addr, uint16_t *reg)
{
	const struct sensor_data *sd = sensors_get();

	LOG_INF("HOLDING_RD called: addr=%u", addr);

	/* Give master HW-519 time to switch from TX to RX */
	k_sleep(K_MSEC(20));

	switch (addr) {
	case 0:
		/* Temperature in °C * 10 */
		*reg = (uint16_t)sd->temp_c_x10;
		break;
	case 1:
		/* Uptime LSW in seconds */
		*reg = sd->uptime_s_lsw;
		break;
	default:
		return -ENOTSUP;
	}

	LOG_INF("Holding read addr %u = %u", addr, *reg);
	return 0;
}

static int holding_reg_wr(uint16_t addr, uint16_t reg)
{
	LOG_WRN("Holding write to addr %u ignored (value %u)", addr, reg);
	return -ENOTSUP;
}

static struct modbus_user_callbacks mbs_cbs = {
	.holding_reg_rd = holding_reg_rd,
	.holding_reg_wr = holding_reg_wr,
};

static struct modbus_iface_param server_param = {
	.mode = MODBUS_MODE_RTU,
	.server = {
		.user_cb = &mbs_cbs,
		.unit_id = SLAVE_UNIT_ID,
	},
	.serial = {
		.baud = 9600,
		.parity = UART_CFG_PARITY_NONE,
		.stop_bits = UART_CFG_STOP_BITS_1,
	},
};

int modbus_server_init(void)
{
	const char iface_name[] = {DEVICE_DT_NAME(MODBUS_NODE)};

	int server_iface = modbus_iface_get_by_name(iface_name);
	if (server_iface < 0) {
		LOG_ERR("No Modbus interface named %s: %d", iface_name, server_iface);
		return server_iface;
	}

	LOG_INF("Starting Modbus RTU server on %s, unit ID %d @ 9600 8N1",
		iface_name, SLAVE_UNIT_ID);

	return modbus_init_server(server_iface, server_param);
}
```

## src/modbus_server.h
```c
#ifndef MODBUS_SERVER_H
#define MODBUS_SERVER_H

int modbus_server_init(void);

#endif /* MODBUS_SERVER_H */
```

## src/sensors.c
```c
#include <zephyr/kernel.h>
#include <zephyr/device.h>
#include <zephyr/drivers/sensor.h>
#include <zephyr/logging/log.h>

#include "sensors.h"

LOG_MODULE_REGISTER(sensors, LOG_LEVEL_INF);

static const struct device *const ds18b20_dev = DEVICE_DT_GET(DT_NODELABEL(ds18b20));
static struct sensor_data data;

void sensors_init(void)
{
	if (!device_is_ready(ds18b20_dev)) {
		LOG_ERR("DS18B20 device not ready");
		data.valid = false;
		return;
	}
	LOG_INF("DS18B20 ready");
	data.valid = true;
	data.temp_c_x10 = 0;
	data.uptime_s_lsw = 0;
}

void sensors_update(void)
{
	struct sensor_value temp_val;

	data.uptime_s_lsw = (uint16_t)(k_uptime_get() / 1000);

	if (!data.valid || !device_is_ready(ds18b20_dev)) {
		return;
	}

	if (sensor_sample_fetch(ds18b20_dev) < 0) {
		LOG_ERR("Failed to fetch DS18B20 sample");
		return;
	}

	if (sensor_channel_get(ds18b20_dev, SENSOR_CHAN_AMBIENT_TEMP, &temp_val) < 0) {
		LOG_ERR("Failed to get DS18B20 temperature");
		return;
	}

	/* Convert to °C * 10 */
	data.temp_c_x10 = (int16_t)(temp_val.val1 * 10 + temp_val.val2 / 100000);
	LOG_DBG("Temp: %d.%06d C -> %d (x10)", temp_val.val1, temp_val.val2, data.temp_c_x10);
}

const struct sensor_data *sensors_get(void)
{
	return &data;
}
```
